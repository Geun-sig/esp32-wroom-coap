## main/Kconfig.projbuild
```kconfig
menu "WiFi Configuration"

    config WIFI_SSID
        string "WiFi SSID"
        default "myssid"
        help
            SSID (network name) to connect to.

    config WIFI_PASSWORD
        string "WiFi Password"
        default "mypassword"
        help
            WiFi password (WPA/WPA2).

endmenu
```

## sdkconfig.defaults
```kconfig
CONFIG_COAP_MBEDTLS_PSK=n
CONFIG_COAP_MBEDTLS_PKI=n
CONFIG_COAP_CLIENT_SUPPORT=y
CONFIG_COAP_TCP_SUPPORT=n
CONFIG_MBEDTLS_SSL_PROTO_DTLS=y
```
